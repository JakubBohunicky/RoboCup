const float motionAngles[361][4] = {
  { 0.353555, 0.353552, -0.353555, -0.353552 },
  { 0.347331, 0.359669, -0.347331, -0.359669 },
  { 0.341001, 0.365675, -0.341001, -0.365675 },
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  { 0, 0, 0, 0 }
};


#include "Wire.h"
#include <MPU6050_light.h>

#define P 2
#define I 0
#define D 0

MPU6050 mpu(Wire);

float outPid;
float error;
float oldError;
float sumI;

float spdA;
float spdB;
float spdC;
float spdD;

int speed = 350;

int line;

#define multiplexerPin1 22  //ir multiplexer pins
#define multiplexerPin2 24
#define multiplexerPin3 26
#define multiplexerPin4 28
#define multiplexerIn A12
#define multiplexerIn1 A13
#define multiplexerIn2 A15

#define motorDPWM 3   //PWM pin motor A
#define motorDINB 25  //INA pin motor A
#define motorDINA 27  //INB pin motor A

#define motorAPWM 5   //PWM pin motor B
#define motorAINB 29  //INA pin motor B
#define motorAINA 33  //INB pin motor B

#define motorCPWM 7   //PWM pin motor C
#define motorCINB 37  //INA pin motor C
#define motorCINA 39  //INB pin motor C

#define motorBPWM 9   //PWM pin motor D
#define motorBINB 43  //INA pin motor D
#define motorBINA 45  //INB pin motor D

const int outputArray[12][4] = {
  { 0, 0, 0, 0 },
  { 0, 0, 0, 1 },
  { 0, 0, 1, 0 },
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  { 1, 0, 1, 1 }
};


const float sensorAngles[12] = { 90, 120, 150, 180, 210, 240, 270, 300, 330, 0, 30, 60 };
const float lightSensorAngles[32] = { 343.125, 354.375, 5.625, 16.875, 28.125, 39.375, 50.625, 61.875, 106.875, 95.625, 84.375, 73.125, 118.125, 129.375, 140.625, 151.875, 163.125, 174.375, 185.625, 196.875, 208.125, 219.375, 230.625, 241.875, 253.125, 264.375, 275.625, 286.875, 298.125, 309.375, 320.625 };
const int lightTreshold[32] = {139, 535, 169, 596, 178, 602, 182, 704, 628, 604, 183, 635, 193, 630, 195, 686, 196, 606, 181, 670, 192, 683, 195, 41,  197, 652, 195, 620, 192, 678, 189, 531};

void define_motors() {
  pinMode(motorAPWM, OUTPUT);  //motor A PWM
  pinMode(motorAINA, OUTPUT);  //motor A INA
  pinMode(motorAINB, OUTPUT);  //motor A INB

  pinMode(motorBPWM, OUTPUT);  //motor B PWM
  pinMode(motorBINA, OUTPUT);  //motor B INA
  pinMode(motorBINB, OUTPUT);  //motor B INB

  pinMode(motorCPWM, OUTPUT);  //motor C PWM
  pinMode(motorCINA, OUTPUT);  //motor C INA
  pinMode(motorCINB, OUTPUT);  //motor C INB

  pinMode(motorDPWM, OUTPUT);  //motor D PWM
  pinMode(motorDINA, OUTPUT);  //motor D INA
  pinMode(motorDINB, OUTPUT);  //motor D INB
}


void define_irMultiplexer() {
  pinMode(multiplexerPin1, OUTPUT);
  pinMode(multiplexerPin2, OUTPUT);
  pinMode(multiplexerPin3, OUTPUT);
  pinMode(multiplexerPin4, OUTPUT);
  pinMode(multiplexerIn, INPUT);
  pinMode(multiplexerIn1, INPUT);
  pinMode(multiplexerIn2, INPUT);
}

void motor(byte id, float spd) {

  switch (id) {
    case 1:
      analogWrite(motorAPWM, spd > 0 ? spd : -spd);
      digitalWrite(motorAINA, spd > 0 ? HIGH : LOW);
      digitalWrite(motorAINB, spd > 0 ? LOW : HIGH);
      break;
    case 2:
      analogWrite(motorBPWM, spd > 0 ? spd : -spd);
      digitalWrite(motorBINA, spd > 0 ? HIGH : LOW);
      digitalWrite(motorBINB, spd > 0 ? LOW : HIGH);
      break;
    case 3:
      analogWrite(motorCPWM, spd > 0 ? spd : -spd);
      digitalWrite(motorCINA, spd > 0 ? HIGH : LOW);
      digitalWrite(motorCINB, spd > 0 ? LOW : HIGH);
      break;
    case 4:
      analogWrite(motorDPWM, spd > 0 ? spd : -spd);
      digitalWrite(motorDINA, spd > 0 ? HIGH : LOW);
      digitalWrite(motorDINB, spd > 0 ? LOW : HIGH);
      break;
  }
}

void motion(float speedA, float speedB, float speedC, float speedD) {
  motor(1, speedA);
  motor(2, speedB);
  motor(3, speedC);
  motor(4, speedD);
}

float errorCalculation() {
  float sumD;

  mpu.update();
  error = mpu.getAngleZ();

  if (error > 180) {
    error -= 360;
  } else if (error < -180) {
    error += 360;
  }

  sumI += error * I;
  sumD = (oldError - error) * D;
  if (error == 0) sumI = 0;
  outPid = (error * P) + sumI + sumD;
  oldError = error;
  return -outPid;
}

uint16_t getBallAngle() {
  float ballAngle = 999;
  float xCor = 0;
  float yCor = 0;
  bool itCheck;
  itCheck = 0;
  for (int irNumber = 0; irNumber < 12; irNumber++) {
    digitalWrite(multiplexerPin1, outputArray[irNumber][0]);
    digitalWrite(multiplexerPin2, outputArray[irNumber][1]);
    digitalWrite(multiplexerPin3, outputArray[irNumber][2]);
    digitalWrite(multiplexerPin4, outputArray[irNumber][3]);

    if (analogRead(multiplexerIn) < 900) {
      itCheck = 1;
      xCor += sin(radians(sensorAngles[irNumber]));
      yCor += cos(radians(sensorAngles[irNumber]));
    }
  }

  if (itCheck == 1) {
    ballAngle = round((atan2(yCor, xCor) * (180 / M_PI)) - 90);

    if (ballAngle == -0) {
      ballAngle = 0;
    } else if (ballAngle < 0) {
      ballAngle += 360;
    }
    ballAngle += 180;
    if (ballAngle > 359) {
      ballAngle -= 360;
    }
  } else {
    ballAngle = 999;
  }
  return ballAngle;
}

uint16_t getLineAngle() {
  float lineAngle = 999;
  float xCor = 0;
  float yCor = 0;
  bool itCheck;
  itCheck = 0;
  for (int lighNumber = 0; lighNumber < 12; lighNumber++) {
    digitalWrite(multiplexerPin1, outputArray[lighNumber][0]);
    digitalWrite(multiplexerPin2, outputArray[lighNumber][1]);
    digitalWrite(multiplexerPin3, outputArray[lighNumber][2]);
    digitalWrite(multiplexerPin4, outputArray[lighNumber][3]);
    if (lighNumber != 3) {
      if (analogRead(multiplexerIn1) < 0) {
        itCheck = 1;
        xCor += sin(radians(lightSensorAngles[lighNumber]));
        yCor += cos(radians(lightSensorAngles[lighNumber]));
      }
      if (analogRead(multiplexerIn2) < 0) {

        itCheck = 1;
        xCor += sin(radians(lightSensorAngles[lighNumber + 16]));
        yCor += cos(radians(lightSensorAngles[lighNumber + 16]));
      }
    }
  }

  if (itCheck == 1) {
    lineAngle = round((atan2(yCor, xCor) * (180 / M_PI)) + 90);

    if (lineAngle == -0) {
      lineAngle = 0;
    } else if (lineAngle < 0) {
      lineAngle += 360;
    }
    lineAngle += 180;
    if (lineAngle > 359) {
      lineAngle -= 360;
    }
  } else {
    lineAngle = 999;
  }

  return lineAngle;
}

int finalAngle(float ang) {
  int finalAngle;
  if (ang != 999) {
    if (ang > 30 and ang <= 180) {
      finalAngle = ang + 45;
    } else if (ang < 330 and ang > 180) {
      finalAngle = ang - 45;
    } else {
      finalAngle = 0;
    }
    if (finalAngle < 0) {
      finalAngle += 360;
    }
    if (finalAngle >= 360) {
      finalAngle -= 360;
    }
  }
  /*
  else {
    finalAngle = 360;
  }
  */
  return finalAngle;
}

void setup() {
  pinMode(19, INPUT);  //switch
  define_motors();
  define_irMultiplexer();
  Serial.begin(9600);
  Wire.begin();
  byte status = mpu.begin();
  while (status != 0) {}  // stop everything if could not connect to MPU6050
  delay(1000);
  mpu.calcOffsets();  // gyro and accelero
  Serial.println("doneeee");
}

void loop() {
  if (digitalRead(19) == 0) {
    while (digitalRead(19) == 0) {
      delay(1);
    }
    while (digitalRead(19) == 1) {
      line = getLineAngle();
      errorCalculation();
      if (line == 999) {
        int a = floor(finalAngle(getBallAngle()));
        Serial.println(a);
        if ((a >= 270 and a < 345) or (a <= 90 and a > 15)) {
          motion((motionAngles[a][0] * speed * 0.6) - outPid, (motionAngles[a][1] * speed * 0.6) - outPid, (motionAngles[a][2] * speed * 0.6) - outPid, (motionAngles[a][3] * speed * 0.6) - outPid);
        } else {
          motion((motionAngles[a][0] * speed) - outPid, (motionAngles[a][1] * speed) - outPid, (motionAngles[a][2] * speed) - outPid, (motionAngles[a][3] * speed) - outPid);
        }
      } else {
        line += 180;
        if (line >= 360) {
          line = line - 360;
        }
        motion((motionAngles[line][0] * speed ) - outPid, (motionAngles[line][1] * speed) - outPid, (motionAngles[line][2] * speed ) - outPid, (motionAngles[line][3] * speed) - outPid);
      }
    }
    while (digitalRead(19) == 0) {
      delay(1);
    }
  }

  motion(0, 0, 0, 0);
}
