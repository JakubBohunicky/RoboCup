#include "High/Modes/mode_controller.h"
#include "High/Roles/role_attacker.h"
#include "Low/Outputs/output_display.h"
#include "Low/Inputs/input_communication.h"
#include "Low/Inputs/input_ps5_controller_buttons.h"

static constexpr unsigned char PROGMEM image_controller_bits[] = {0x00,0x00,0x00,0x00,0x00,0x00,0x00,0x00,0x00,0x00,0x00,0x00,0x00,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0x00,0x00};

static void _drawScreen_CONTROLLER() {
    OUT::display.needsUpdate = true;

    // display.setTextColor(1);
    // display.setTextWrap(false);


    if(IN::comms.onlineController == false) {
        IN::comms.onlineController = input_comm_enable_controller_peer_();
    }

    if(IN::comms.onlineController == true) {
        display.drawBitmap(32, 0, image_controller_bits, 64, 64, 1);
    } else {
        display.setCursor(29, 29);
        display.print("Connecting...");
    }
}


namespace Mode {
    void controller() {
        if(ST::state.mode_previous != ST::Types::mode_t::Controller || IN::comms.onlineController == false) { _drawScreen_CONTROLLER(); OUT::motorAcc.motEn = true;}
            // ST::robot changed aj pre mac espnow nechs sa prepoji

        if(IN::comms.onlineController == true) {
            input_comm_controller_update();
            input_controller_buttons_update();

            //sprtavit aj feedback na svetla a vibracie picovinky XXDDDD top

            if(ST::controller.autoPlay == false) {
                

            } else { //auto-play
                Role::attack();
            }
        }
    } 
}