#include <Arduino.h>
#include <Wire.h>
#include <Adafruit_I2CDevice.h>
#include <Adafruit_GFX.h>
#include <Adafruit_SSD1306.h>
#include "Adafruit_HTU21DF.h"

TwoWire I2C_1 = TwoWire(1);


Adafruit_HTU21DF htu;  


static Adafruit_SSD1306 display(128, 64, &Wire, -1, 1000000UL, 1000000UL);


float temp = 0.0f;
float rel_hum = 0.0f;

void drawScreen_1(void);

  int state = 1;
  bool wifi = true;
  int gyroS = 3;
  int gyroG = 2;
  int gyroA = 1;
  int gyroM = 0;
  bool goal = true;
  int mode = 0;
  int speed = 100;
  float gyroOffset = 157.00;
  bool robotOn = false;
  uint32_t robotLastOnTime = 0;
  bool speedMenu = false;


  bool btnPlusClick = false;
  bool  btnMinusClick = false;

  bool  btnPlusLongPress = false;
  bool  btnMinusLongPress = false;

  bool  btnPlusIsDown = false;
  bool  btnMinusIsDown = false;




// #include <Wire.h>
// #include <FastADC_Mux.h>
// #include "Low/config_hw.h"
#include "driver/gpio.h"

struct BTNs { //button state4
    gpio_num_t pin;
    bool LastPos = false;
    bool StablePos = false;
    uint32_t ChangeTime = 0;

    bool Click = false;
    bool LongPress = false;
    bool IsDown = false;
    
    uint32_t PressStartTime = 0;
    bool LongSent = false;
};

constexpr int BTN_DEBOUNCE_MS = 20;
constexpr int BTN_LONGPRESS_MS = 500;

BTNs btnSPlus;
BTNs btnSMinus;

// void I2C_FastADC_init_() {

//     Wire.begin(HW::GenericCfg::I2C_SDA_Pin, HW::GenericCfg::I2C_SCL_Pin);
//     Wire.setClock(400000); //MAX 800kHz

//     fadcInit(8, HW::LineCfg::Line_A_Read_Pin, HW::LineCfg::Line_B_Read_Pin, HW::LineCfg::Line_X_Read_Pin, HW::MotionSenseCfg::A_Spd_Pin, HW::MotionSenseCfg::B_Spd_Pin, HW::MotionSenseCfg::C_Spd_Pin, HW::MotionSenseCfg::D_Spd_Pin, HW::MotionSenseCfg::DRBFR_Spd_Pin);

// }


void input_generic_init_() {
    gpio_set_direction(GPIO_NUM_20, GPIO_MODE_INPUT);
    gpio_set_pull_mode(GPIO_NUM_20, GPIO_PULLUP_ONLY);
    gpio_set_direction(GPIO_NUM_19, GPIO_MODE_INPUT);
    gpio_set_pull_mode(GPIO_NUM_19, GPIO_PULLUP_ONLY);

    gpio_set_direction(GPIO_NUM_35, GPIO_MODE_OUTPUT);

    gpio_set_direction(GPIO_NUM_36, GPIO_MODE_OUTPUT);

    gpio_set_direction(GPIO_NUM_37, GPIO_MODE_OUTPUT);

    // gpio_set_direction(HW::GenericCfg::BukajModule_Pin, GPIO_MODE_INPUT);
    // gpio_set_pull_mode(HW::GenericCfg::BukajModule_Pin, GPIO_PULLUP_ONLY);    

    btnSMinus.pin = GPIO_NUM_19;
    btnSPlus.pin = GPIO_NUM_20;
}



static void _input_generic_btn_update(BTNs& btn) {
    btn.Click = false;
    btn.LongPress = false;
    uint32_t now = millis();

    bool raw = !gpio_get_level(btn.pin); //active LOW

    if(raw != btn.StablePos) { //edge detection
        if(now - btn.ChangeTime >= BTN_DEBOUNCE_MS) { //debounde
            btn.StablePos = raw;
            btn.ChangeTime = now;
            
            if(btn.StablePos == true) {
              btn.PressStartTime = now;
              btn.LongSent = false;
            }
        }
    }

    btn.IsDown = btn.StablePos;
    btn.Click = (btn.LastPos == true && btn.StablePos == false && btn.LongSent == false);

    if(btn.StablePos == true && btn.LongSent == false) {
        if(now - btn.PressStartTime >= BTN_LONGPRESS_MS) {
            btn.LongPress = true;
            btn.LongSent = true; //dont send again
        }
    }

    btn.LastPos = btn.StablePos;
}

void input_generic_update() {

    // IN::generic.bukajModuleEn = gpio_get_level(HW::GenericCfg::BukajModule_Pin);

    _input_generic_btn_update(btnSPlus);
    _input_generic_btn_update(btnSMinus);

    btnPlusClick = btnSPlus.Click;
    btnMinusClick = btnSMinus.Click;

    btnPlusLongPress = btnSPlus.LongPress;
    btnMinusLongPress = btnSMinus.LongPress;

    btnPlusIsDown = btnSPlus.IsDown;
    btnMinusIsDown = btnSMinus.IsDown;
}


void state_update() {


    if(robotOn) {
        if(btnMinusIsDown || btnPlusIsDown) {
            robotOn = false;
            robotLastOnTime = millis();
        }
    }

    if(speedMenu == false) {

        if(btnPlusClick && millis() - robotLastOnTime >= 1000) {
            robotOn = true;
        }

        // Serial.println("After");
        if(btnMinusClick) state++;
        //   if(btnPlusClick) state++;
        //   if(btnPlusLongPress) state += 10;
        //   if(btnMinusLongPress) state -= 10;

        if(state > 2) state = 0;
        // if(state < 0) state = 3;


        if(btnMinusLongPress) {gyroOffset = random(0, 359.99);}

    }

    switch (state)
    {
    case 0: 
            if(btnPlusLongPress) {
                goal = !goal;
            }
        break;
    case 1: 
            if(btnPlusLongPress) {
                mode++;
                if(mode >= 3) mode = 0;
            }

        break;
    case 2:
            if(speedMenu == true && (btnPlusLongPress || btnMinusLongPress)) speedMenu = false;

            else if(btnPlusLongPress && speedMenu == false) {
                speedMenu = true;
            }

            if(speedMenu) {
                if(btnPlusClick) speed += 5;
                if(btnMinusClick) speed -= 5;

            }
        break;
    default:
        break;
    }
}

void setup() {
  Serial.begin(921600);



  Serial.print(__TIME__);
  Serial.print("   ");
  Serial.println(__DATE__);

  Wire.begin(8, 9);

    I2C_1.begin(1, 2, 100000); 

  if (!display.begin(SSD1306_SWITCHCAPVCC, 0x3C, true, false)) {  // skús 0x3D ak nič
    Serial.println("SSD1306 begin failed");
  }

  Serial.println("HTU21D-F test");

  if (!htu.begin(&I2C_1)) {
    Serial.println("Couldn't find sensor!");
  }


  input_generic_init_();
  
//   Wire.setClock(200000); //MAX 800kHz 

  display.display();
  display.clearDisplay();
  display.display();

}

//MENU:
//GYRO RESET
//BRANKA
//SPEED
void humidity();

void loop() {
    // Serial.println(Wire.getClock());
  //Serial.println("before");
//   gpio_set_level(GPIO_NUM_35, 1);
  gpio_set_level(GPIO_NUM_36, 1);
//   gpio_set_level(GPIO_NUM_37, 1);

    humidity();

  input_generic_update();

    state_update();
    display.clearDisplay();
    drawScreen_1();
    gpio_set_level(GPIO_NUM_36, 0);
    display.display();

    // gpio_set_level(GPIO_NUM_35, 0);
    // gpio_set_level(GPIO_NUM_37, 0);
    //delay(10);

}



static const unsigned char PROGMEM image_Layer_7_bits[] = {0x00,0x30,0x00,0x00,0x30,0x00,0x00,0x30,0x00,0x00,0x30,0x00,0x00,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0xff,0x00};

static const unsigned char PROGMEM image_plant_bits[] = {0x00,0x00,0x00,0x0f,0x00,0x00,0x00,0x0f,0x00,0x00,0x00,0xff,0x00,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0x00,0x00};

static const unsigned char PROGMEM image_refresh_bits[] = {0x00,0x00,0x00,0x00,0x00,0x00,0x00,0x00,0x00,0xff,0xc3,0x00,0x00,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0x00,0x00};

static const unsigned char PROGMEM image_weather_frost_bits[] = {0x00,0x03,0x00,0x00,0x00,0x03,0x00,0x00,0x03,0x0f,0xc3,0x00,0x03,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0x00,0x00};

static const unsigned char PROGMEM image_weather_humidity_bits[] = {0x00,0x30,0x00,0x00,0x30,0x00,0x00,0x30,0x00,0x00,0x30,0x00,0x00,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0xff,0x00};

static const unsigned char PROGMEM image_weather_humidity_white_bits[] = {0x00,0x30,0x00,0x00,0x30,0x00,0x00,0x30,0x00,0x00,0x30,0x00,0x00,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0xff,0x00};

static const unsigned char PROGMEM image_weather_sun_bits[] = {0x00,0x03,0x00,0x00,0x00,0x03,0x00,0x00,0x0c,0x03,0x00,0xc0,0x0c,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0x00,0x00};

static const unsigned char PROGMEM image_weather_temperature_bits[] = {0x03,0xf0,0x00,0x00,0x03,0xf0,0x00,0x00,0x0c,0x0c,0x00,0x0c,0x0c,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0x00,0x00};




void drawScreen_1(void) {

        
    // weather_temperature
    display.drawBitmap(56, 3, image_weather_temperature_bits, 32, 32, 1);

    // Layer 6 copy 1
    display.setTextColor(1);
    display.setTextSize(2);
    display.setTextWrap(false);
    display.setCursor(4, 7);
    display.print(temp, 1);


    // Layer 6
    display.setCursor(41, 44);
    display.print(rel_hum, 1);

    
    // Layer 7
    display.drawBitmap(104, 31, image_Layer_7_bits, 22, 32, 1);
    
    // refresh
    if(temp >= 24.5)
        display.drawBitmap(96, 0, image_refresh_bits, 26, 32, 1);
    
    // weather_frost
    else if(temp <= 19)
        display.drawBitmap(94, 1, image_weather_frost_bits, 30, 32, 1);

    // weather_sun
    else
        display.drawBitmap(94, 0, image_weather_sun_bits, 30, 32, 1);

    // weather_humidity
    if(rel_hum < 40)
        display.drawBitmap(8, 31, image_weather_humidity_white_bits, 22, 32, 1);
    
    // weather_humidity_white
    else if (rel_hum > 60)
        display.drawBitmap(8, 31, image_weather_humidity_bits, 22, 32, 1);
    
    // plant
    else
        display.drawBitmap(5, 31, image_plant_bits, 32, 32, 1);
}



void humidity() {
    /***************************************************
  This is an example for the HTU21D-F Humidity & Temp Sensor

  Designed specifically to work with the HTU21D-F sensor from Adafruit
  ----> https://www.adafruit.com/products/1899

  These displays use I2C to communicate, 2 pins are required to
  interface
 ****************************************************/

    temp = htu.readTemperature();
    rel_hum = htu.readHumidity();
    Serial.print("Temp: "); Serial.print(temp); Serial.print(" C");
    Serial.print("\t\t");
    Serial.print("Humidity: "); Serial.print(rel_hum); Serial.println(" \%");
//    delay(500);
}